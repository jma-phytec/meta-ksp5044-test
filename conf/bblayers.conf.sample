## conf/bblayers.conf.sample
```bitbake
# POKY_BBLAYERS_CONF_VERSION is increased each time build/conf/bblayers.conf
# changes incompatibly
POKY_BBLAYERS_CONF_VERSION = "2"

BBPATH = "${TOPDIR}"
BBFILES ?= ""

OEROOT := "##OEROOT##"
# add BSPDIR variable, as it is needed by recipes of NXP
BSPDIR := "${OEROOT}/../.."

# In our BSPs active layers are defined by the manifest.xml for all BSPs. The
# bblayers.conf gets created by the init_bblayers.py script.
BBLAYERS ?= " \
  ${OEROOT}/../meta-ksp5044 \
  "
BBLAYERS += "\
  ${OEROOT}/../poky/meta \
  ${OEROOT}/../poky/meta-poky \
  ${OEROOT}/../meta-openembedded/meta-oe \
  ${OEROOT}/../meta-openembedded/meta-networking \
  ${OEROOT}/../meta-openembedded/meta-python \
  ${OEROOT}/../meta-openembedded/meta-multimedia \
  ${OEROOT}/../meta-openembedded/meta-filesystems \
  ${OEROOT}/../meta-openembedded/meta-perl \
  ${OEROOT}/../meta-qt5 \
  ${OEROOT}/../meta-rauc \
  ${OEROOT}/../meta-security \
  ${OEROOT}/../meta-security/meta-tpm \
  ${OEROOT}/../meta-ampliphy \
  ${OEROOT}/../meta-phytec \
  "
```

## conf/layer.conf
```bitbake
# We have a conf and classes directory, add to BBPATH
BBPATH .= ":${LAYERDIR}"

# We have recipes-* directories, add to BBFILES
BBFILES += "${LAYERDIR}/recipes-*/*/*.bb \
            ${LAYERDIR}/recipes-*/*/*.bbappend"

BBFILE_COLLECTIONS += "meta-ksp5044"
BBFILE_PATTERN_meta-ksp5044 = "^${LAYERDIR}/"
BBFILE_PRIORITY_meta-ksp5044 = "23"

LAYERDEPENDS_meta-ksp5044 = "core"
LAYERSERIES_COMPAT_meta-ksp5044 = "hardknott"
```

## conf/machine/ksp5044-imx6-1.conf
```bitbake
#@TYPE: Machine
#@NAME: ksp5044-imx6-1
#@DESCRIPTION: PHYTEC phyBOARD-Mira full-featured i.MX6 Quad, 2GiB RAM, 8GiB eMMC
#@ARTICLENUMBERS: PBA-C-26-XXX.XX, PCM-073-XXXXXXXXX.XX

require conf/machine/include/phyimx6qdl.inc

SOC_FAMILY .= ":mx6q"
SOC_FAMILY .= ":phyboard-mira-imx6"

# Kernel
KERNEL_DEVICETREE = "imx6q-phytec-mira-ff-rdk-emmc.dtb"

# Barebox Config
BAREBOX_BASE_BIN = "barebox-phytec-phycore-imx6q-som-emmc-2gib"

MACHINE_FEATURES += "resistivetouch pci can wifi bluetooth emmc alsa"

SERIAL_CONSOLES = "115200;ttymxc1"
```
